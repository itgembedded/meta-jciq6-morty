## conf/layer.conf
```bitbake
# We have a conf and classes directory, add to BBPATH
BBPATH .= ":${LAYERDIR}"

# We have a packages directory, add to BBFILES
BBFILES += "${LAYERDIR}/recipes-*/*/*.bb \
            ${LAYERDIR}/recipes-*/*/*.bbappend"

BBFILE_COLLECTIONS += "jciq6"
BBFILE_PATTERN_jciq6 := "^${LAYERDIR}/"
BBFILE_PRIORITY_jciq6 = "6"

# Add the Freescale-specific licenses into the metadata
LICENSE_PATH += "${LAYERDIR}/custom-licenses"

FSL_EULA_FILE = "${LAYERDIR}/EULA"

IMX_MIRROR ?= "http://www.freescale.com/lgfiles/NMG/MAD/YOCTO/"
QORIQ_MIRROR ?= "http://git.freescale.com/source/"

# FIXME: set this to avoid changing all the recipes that use it
FSL_MIRROR ?= "${IMX_MIRROR}"

MIRRORS += " \
${IMX_MIRROR}   http://download.ossystems.com.br/bsp/freescale/source/ \n \
${QORIQ_MIRROR} http://download.ossystems.com.br/bsp/freescale/source/ \n \
"

# The dynamic-layers directory hosts the extensions and layer specific
# modifications related to Freescale products.
#
# The .bbappend and .bb files are included if the respective layer
# collection is available.
BBFILES += "${@' '.join('${LAYERDIR}/dynamic-layers/%s/recipes*/*/*.bbappend' % layer \
               for layer in BBFILE_COLLECTIONS.split())}"
BBFILES += "${@' '.join('${LAYERDIR}/dynamic-layers/%s/recipes*/*/*.bb' % layer \
               for layer in BBFILE_COLLECTIONS.split())}"
```

## conf/machine/jciq6p.conf
```bitbake
#@TYPE: Machine
#@NAME: JCI Q6 Plus Board
#@SOC: i.MX6QP
#@DESCRIPTION: Machine configuration for JCI Q6 Plus Board
#@MAINTAINER: Phil Flournoy <phil@itgembedded.com>

MACHINEOVERRIDES =. "mx6:mx6q:"

require conf/machine/include/jciq6-common.inc

PREFFERED_PROVIDER_u-boot = "u-boot-jciq6"
PREFFERED_PROVIDER_u-boot_mx6 = "u-boot-jciq6"
PREFFERED_PROVIDER_virtual/bootloader = "u-boot-jciq6"
UBOOT_MACHINE ?= "jciq6p_defconfig"

PREFFERED_PROVIDER_virtual/kernel_mx6 = "linux-jciq6"
PREFERRED_VERSION_linux-jciq6 ?= "4.1"

KERNEL_IMAGETYPE = "zImage"

KERNEL_DEVICETREE = "imx6q-jciq6.dtb imx6q-jciq6-640.dtb imx6qp-jciq6.dtb imx6qp-jciq6-640.dtb" 

UBOOT_CONFIG ??= "sd"
UBOOT_CONFIG[sd] = "jciq6p_config,sdcard"
UBOOT_CONFIG[sata] = "jciq6p_sata_config"
UBOOT_CONFIG[mfgtool] = "jciq6p_config"
```
